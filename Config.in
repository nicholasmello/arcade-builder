## package/buildinfo-nodes/Config.in.host
```kconfig
config BR2_PACKAGE_HOST_BUILDINFO_NODES
	bool "buildinfo-nodes"
	help
		Build information containing build date and time

		https://www.nmello.dev
```

## package/buildinfo-reader/Config.in
```kconfig
config BR2_PACKAGE_BUILDINFO_READER
	bool "buildinfo-reder"
	help
		Script to read build info placed by the buildinfo-nodes host package

		https://www.nmello.dev
```

## package/buildinfo/Config.in
```kconfig
config BR2_PACKAGE_BUILDINFO
	bool "buildinfo"
	help
		Build information containing build date and time

		https://www.nmello.dev
```

## package/qt-test/Config.in
```kconfig
config BR2_PACKAGE_QT_TEST
	bool "qt-test"
	depends on BR2_PACKAGE_QT5
	select BR2_PACKAGE_QT5BASE_WIDGETS
	help
		This is an example hello world app to make sure qt is working
```

## package/rust-hello/Config.in
```kconfig
config BR2_PACKAGE_RUST_HELLO
	bool "rust-hello"
	depends on BR2_PACKAGE_HOST_RUSTC_TARGET_ARCH_SUPPORTS
	select BR2_PACKAGE_HOST_RUSTC
	help
		A hello world utility written in rust to prove ability to
		compile rust applications

		https://www.nmello.dev
```

## support/package/Config.in
```kconfig
config BR2_EXAMPLE_PACKAGE_NAME
	bool "example_package"
	help
		TODO: Write package description

		https://www.nmello.dev
```
